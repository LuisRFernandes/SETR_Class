## Assigment4/build/Kconfig/Kconfig.shield
```kconfig
osource "c:/users/luisc/desktop/setr_assigment4/boards/shields/*/Kconfig.shield"
osource "C:/ncs/v2.6.0/nrf/boards/shields/*/Kconfig.shield"
```

## Assigment4/build/Kconfig/Kconfig.shield.defconfig
```kconfig
osource "c:/users/luisc/desktop/setr_assigment4/boards/shields/*/Kconfig.defconfig"
osource "C:/ncs/v2.6.0/nrf/boards/shields/*/Kconfig.defconfig"
```
